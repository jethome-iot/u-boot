## board/amlogic/jethub_j300/Kconfig
```kconfig
if TARGET_JETHUB_J300

config SYS_SOC
	default "s7d"

config SYS_BOARD
	default "jethub_j300"

config SYS_CONFIG_NAME
	default "jethub_j300"

config DTB_BIND_KERNEL
    bool "load dtb from boot part but not flash rsv"
    default n

config BL30_SELECT
	string "s7d BL30 board config"
		default "s7d_bm202"

config AML_REBOOT
		bool "reboot cmd"
		default y
		help
			support uboot reboot cmd

config ENABLE_AML_GPIO_UPGRADE
    bool "upgrade key check"
    default n

config AML_GPIO_UPGRADE_KEY
    string "gpio key"
    default ""

endif
```

## board/amlogic/jethub_j310/Kconfig
```kconfig
if TARGET_JETHUB_J310

config SYS_SOC
	default "s7"

config SYS_BOARD
	default "jethub_j310"

config SYS_CONFIG_NAME
	default "jethub_j310"

config DTB_BIND_KERNEL
    bool "load dtb from boot part but not flash rsv"
    default n

config AML_REBOOT
		bool "reboot cmd"
		default y
		help
			support uboot reboot cmd

config ENABLE_AML_GPIO_UPGRADE
    bool "upgrade key check"
    default n

config AML_GPIO_UPGRADE_KEY
    string "gpio key"
    default ""

endif
```

## configs/jethub_j300_defconfig
```kconfig
CONFIG_ARM=y
CONFIG_ARCH_MESON=y
CONFIG_DM_GPIO=y
CONFIG_DEFAULT_DEVICE_TREE="meson-s7d-jethome-jethub-j300"
CONFIG_SYS_PROMPT="jethub_j300# "
CONFIG_MESON_S7D=y
CONFIG_AMLOGIC_MODIFY=y
CONFIG_SECURE_POWER_CONTROL=y
CONFIG_AML_TSENSOR=y
CONFIG_AML_TSENSOR_COOL=y
CONFIG_AMLOGIC_ETH=y
CONFIG_AMLOGIC_EMMC=y
CONFIG_BL2E_96K=y
CONFIG_S7D_BM202=y
CONFIG_DEBUG_UART_BASE=0xfe07a000
CONFIG_DEBUG_UART_CLOCK=24000000
CONFIG_DEBUG_UART=y
CONFIG_BAUDRATE=921600
CONFIG_OF_BOARD_SETUP=y
CONFIG_CMD_SETEXPR=y
CONFIG_CMD_SOURCE=y
CONFIG_CMD_CLK=y
CONFIG_CMD_GPIO=y
CONFIG_CMD_I2C=y
CONFIG_CMD_MMC=y
CONFIG_CMD_MTD=y
CONFIG_CMD_USB=y
CONFIG_CMD_WDT=y
CONFIG_CMD_CACHE=y
CONFIG_CMD_MTDPARTS=y
CONFIG_CMD_CLKMSR=y
CONFIG_CMD_SF=y
CONFIG_AML_STORAGE=y
# CONFIG_AML_PARTITION is not set
CONFIG_OF_CONTROL=y
CONFIG_OF_EMBED=y
# CONFIG_ENV_IS_IN_STORAGE is not set
CONFIG_ENV_IS_NOWHERE=y
CONFIG_ADC=y
CONFIG_CLK=y
CONFIG_DM_I2C=y
CONFIG_SYS_I2C_MESON=y
CONFIG_MISC=y
CONFIG_MMC_HS200_SUPPORT=y
CONFIG_MMC_MESON_GX=y
CONFIG_MTD=y
CONFIG_PHYLIB=y
CONFIG_PHY=y
CONFIG_PINCTRL=y
CONFIG_DM_REGULATOR=y
CONFIG_DM_PWM=y
CONFIG_PWM_MESON=y
CONFIG_DM_RESET=y
CONFIG_DEBUG_UART_ANNOUNCE=y
CONFIG_DEBUG_UART_SKIP_INIT=y
CONFIG_MESON_SERIAL=y
CONFIG_USB=y
CONFIG_USB_XHCI_HCD=y
CONFIG_USB_GADGET=y
CONFIG_USB_GADGET_CRG=y
CONFIG_USB_FUNCTION_FASTBOOT=y
CONFIG_FASTBOOT_FLASH=y
CONFIG_FASTBOOT_FLASH_MMC_DEV=0
CONFIG_AMLOGIC_USB=y
CONFIG_USB_XHCI_CRG=y
CONFIG_AMLOGIC_USB2_PHY=y
CONFIG_AMLOGIC_USB3_PHY=y
# CONFIG_WATCHDOG_AUTOSTART is not set
CONFIG_WDT=y
CONFIG_WDT_MESON=y
CONFIG_AML_DRIVER=y
CONFIG_PHY_AMLOGIC=y
CONFIG_PINCTRL_MESON_S7D=y
CONFIG_AMLOGIC_SARADC=y
CONFIG_AMLOGIC_AMFC=y
CONFIG_ZSTD=y
CONFIG_OF_LIBFDT_OVERLAY=y
CONFIG_BOOTDELAY=50
CONFIG_COUNTER_FREQUENCY=24000000
CONFIG_SPI=y
CONFIG_DM_SPI=y
CONFIG_SPI_FLASH=y
CONFIG_DM_SPI_FLASH=y
CONFIG_AMLOGIC_SPIFC=y
CONFIG_SPI_FLASH_MACRONIX=y
CONFIG_SPI_FLASH_MICRON=y
# CONFIG_AML_ROBUST is not set
# CONFIG_DISPLAY_CPUINFO is not set
CONFIG_EFUSE=y

CONFIG_USE_BOOTCOMMAND=y
CONFIG_BOOTCOMMAND="setenv devtype mmc; setenv devnum 0; if load mmc 0 0x12000000 boot/boot.scr; then source 0x12000000; else setenv devnum 1; load mmc 1 0x12000000 boot/boot.scr && source 0x12000000; fi"
CONFIG_USE_PREBOOT=y
CONFIG_PREBOOT="echo Armbian boot"
```

## configs/jethub_j300y5_defconfig
```kconfig
CONFIG_ARM=y
CONFIG_ARCH_MESON=y
CONFIG_DM_GPIO=y
CONFIG_DEFAULT_DEVICE_TREE="meson-s7-jethome-jethub-j300y5"
CONFIG_SYS_PROMPT="jethub_j300y5# "
CONFIG_MESON_S7=y
CONFIG_AMLOGIC_MODIFY=y
CONFIG_SECURE_POWER_CONTROL=y
CONFIG_AML_TSENSOR=y
CONFIG_AML_TSENSOR_COOL=y
CONFIG_AMLOGIC_ETH=y
CONFIG_AMLOGIC_EMMC=y
CONFIG_JETHUB_J300Y5=y
CONFIG_DEBUG_UART_BASE=0xfe07a000
CONFIG_DEBUG_UART_CLOCK=24000000
CONFIG_ARMV8_CRYPTO=y
CONFIG_DEBUG_UART=y
CONFIG_OF_BOARD_SETUP=y
CONFIG_USE_PREBOOT=y
# CONFIG_DISPLAY_CPUINFO is not set
CONFIG_BOARD_LATE_INIT=y
CONFIG_CMD_SETEXPR=y
CONFIG_CMD_SOURCE=y
CONFIG_CMD_CLK=y
CONFIG_CMD_GPIO=y
CONFIG_CMD_I2C=y
CONFIG_CMD_MMC=y
CONFIG_CMD_GPT=y
CONFIG_CMD_MTD=y
CONFIG_CMD_USB=y
CONFIG_CMD_WDT=y
CONFIG_CMD_CACHE=y
CONFIG_CMD_MTDPARTS=y
CONFIG_CMD_CLKMSR=y
CONFIG_CMD_SF=y
CONFIG_AML_STORAGE=y
# CONFIG_AML_PARTITION is not set
CONFIG_OF_CONTROL=y
CONFIG_OF_EMBED=y
# CONFIG_ENV_IS_IN_STORAGE is not set
CONFIG_ENV_IS_IN_MMC=y
CONFIG_ENV_SIZE=0x10000
CONFIG_ENV_OFFSET=0x380000
CONFIG_SYS_MMC_ENV_DEV=1
CONFIG_ADC=y
CONFIG_CLK=y
CONFIG_USB_FUNCTION_FASTBOOT=y
CONFIG_FASTBOOT_FLASH=y
CONFIG_FASTBOOT_FLASH_MMC_DEV=0
CONFIG_DM_I2C=y
CONFIG_SYS_I2C_MESON=y
CONFIG_MISC=y
CONFIG_MMC_HS200_SUPPORT=y
CONFIG_MMC_MESON_GX=y
CONFIG_MTD=y
CONFIG_PHYLIB=y
CONFIG_PHY=y
CONFIG_PINCTRL=y
CONFIG_DM_REGULATOR=y
CONFIG_DM_PWM=y
CONFIG_PWM_MESON=y
CONFIG_DM_RESET=y
CONFIG_DEBUG_UART_ANNOUNCE=y
CONFIG_DEBUG_UART_SKIP_INIT=y
CONFIG_MESON_SERIAL=y
CONFIG_SPI=y
CONFIG_DM_SPI=y
CONFIG_USB=y
CONFIG_USB_XHCI_HCD=y
CONFIG_USB_GADGET=y
CONFIG_USB_GADGET_CRG=y
CONFIG_AML_V3_FACTORY_BURN=y
CONFIG_AML_V3_USB_TOOl=y
# CONFIG_WATCHDOG_AUTOSTART is not set
CONFIG_WDT=y
CONFIG_WDT_MESON=y
CONFIG_AML_DRIVER=y
CONFIG_PHY_AMLOGIC=y
CONFIG_PINCTRL_MESON_S7=y
CONFIG_AMLOGIC_USB=y
CONFIG_USB_XHCI_CRG=y
CONFIG_AMLOGIC_USB2_PHY=y
CONFIG_AMLOGIC_USB3_PHY=y
CONFIG_AMLOGIC_SARADC=y
CONFIG_ZSTD=y
CONFIG_OF_LIBFDT_OVERLAY=y
CONFIG_BOOTDELAY=5
# CONFIG_AML_ROBUST is not set
CONFIG_EFUSE=y
CONFIG_BOOTCOMMAND="setenv devtype mmc; setenv devnum 1; if load mmc 0 0x12000000 boot/boot.scr; then setenv devnum 0; source 0x12000000; else if load mmc 1:1 0x12000000 boot/boot.scr; then source 0x12000000; else echo Normal boot failed, trying recovery...; run boot_recovery; fi; fi"
CONFIG_MTD_BLOCK=y
CONFIG_MTD_PARTITIONS=y
CONFIG_SHA256=y
CONFIG_FIT=y
```
