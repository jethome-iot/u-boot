## board/amlogic/jethub_j82/Kconfig
```kconfig
if TARGET_JETHUB_J82

config SYS_SOC
	default "s4"

config SYS_BOARD
	default "jethub_j82"

config SYS_VENDOR
	default "amlogic"

config SYS_CONFIG_NAME
	default "jethub_j82"

config DTB_BIND_KERNEL
    bool "load dtb from boot part but not flash rsv"
    default n

config CMD_PLLTEST
	bool "support plltest command"
	default n
	help
	  support plltest command

config AML_REBOOT
       bool "reboot cmd"
       default y
       help
         support uboot reboot cmd
endif
```

## configs/jethub_jxd_a1c1_defconfig
```kconfig
CONFIG_ARM=y
CONFIG_ARCH_SUNXI=y
CONFIG_SYS_BOARD="jethub-jxd-cpu-a1c1"
CONFIG_SYS_VENDOR="sunxi"
CONFIG_DEFAULT_DEVICE_TREE="sun8i-t113s-jxd-cpu-a1c1"
CONFIG_SPL=y
CONFIG_MACH_SUN8I_R528=y
CONFIG_DRAM_CLK=792
CONFIG_DRAM_ZQ=8092667
CONFIG_SUNXI_MINIMUM_DRAM_MB=128
# CONFIG_SYS_MALLOC_CLEAR_ON_INIT is not set
CONFIG_DRAM_SUNXI_ODT_EN=0
CONFIG_DRAM_SUNXI_TPR0=0x004a2195
CONFIG_DRAM_SUNXI_TPR11=0x340000
CONFIG_DRAM_SUNXI_TPR12=0x46
CONFIG_DRAM_SUNXI_TPR13=0x34000100
CONFIG_CONS_INDEX=4
CONFIG_SUN8I_EMAC=y
CONFIG_SPI=y
CONFIG_SPL_SPI_SUNXI=y
CONFIG_SPL_SPI_SUNXI_NAND=y
CONFIG_SPL_SPI_SUNXI_NAND_ASSUMED_PAGESIZE=0x800
#CONFIG_SPL_STACK=0x8000
CONFIG_SYS_SPI_U_BOOT_OFFS=0x8000

CONFIG_CMD_MTD=y
# CONFIG_CMD_SF is not set
CONFIG_CMD_MTDPARTS=y
CONFIG_CMD_UBI=y
CONFIG_CMD_UBIFS=y
# CONFIG_ENV_IS_IN_FAT is not set
# CONFIG_ENV_IS_IN_SPI_FLASH is not set
#CONFIG_ENV_IS_IN_NAND=y
#CONFIG_ENV_OFFSET=0x400000
#CONFIG_ENV_IS_IN_UBI=y
#CONFIG_ENV_UBI_PART="ubi"
#CONFIG_ENV_UBI_VOLUME="env"
# CONFIG_NET is not set
#CONFIG_MTD_RAW_NAND=y
#CONFIG_MTDPARTS_DEFAULT="mtdparts=flash@0:-(sf)"
#CONFIG_MTDPARTS_DEFAULT="mtdparts=47040000.spi.0:512k(ospi.tiboot3),2m(ospi.tispl),4m(ospi.u-boot),128k(ospi.env),128k(ospi.env.backup),1m(ospi.sysfw),-@8m(ospi.rootfs);47034000.hyperbus:512k(hbmc.tiboot3),2m(hbmc.tispl),4m(hbmc.u-boot),256k(hbmc.env),1m(hbmc.sysfw),-@8m(hbmc.rootfs)"
CONFIG_MTDPARTS_DEFAULT="spi-nand0:32k(spl),4064k(u-boot),8k(env),64k(dtb),952k(align0),10240k(kernela),10240k(kernelb),105472k(ubi)"
CONFIG_MTD=y
CONFIG_MTD_UBI=y

CONFIG_DM_MTD=y
CONFIG_MTD_SPI_NAND=y
# CONFIG_SPI_FLASH is not set
CONFIG_SF_DEFAULT_SPEED=25000000
# CONFIG_UBI_SILENCE_MSG is not set
# CONFIG_UBIFS_SILENCE_MSG is not set
CONFIG_SHOW_ERRORS=y

CONFIG_USB=y
CONFIG_CMD_USB=y
CONFIG_DM_USB_GADGET=y
CONFIG_USB_EHCI_HCD=y
CONFIG_USB_OHCI_HCD=y
CONFIG_USB_STORAGE=y
```

## drivers/amlogic/Kconfig
```kconfig
menu "AMLOGIC Drivers"

config AML_DRIVER
	bool "AML drivers Support"
	select SHA1
	select SHA256
	help
	  Enable support for the Amlogic drivers.

source "drivers/amlogic/keymanage/Kconfig"

source "drivers/amlogic/storagekey/Kconfig"

endmenu
```
